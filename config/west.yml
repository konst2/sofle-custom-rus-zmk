## config/west.yml
```yaml
manifest:
  defaults:
    revision: v0.3
  remotes:
    - name: zmkfirmware
      url-base: https://github.com/zmkfirmware
    # Additional modules containing boards/shields/custom code can be listed here as well
    # See https://docs.zephyrproject.org/3.2.0/develop/west/manifest.html#projects
    - name: konst2
      url-base: https://github.com/konst2
  projects:
    - name: zmk
      revision: v0.3.0
      remote: zmkfirmware
      import: app/west.yml
    - name: zmk-lang-agnostic-behaviors
      remote: konst2
      revision: main
  self:
    path: config
```
